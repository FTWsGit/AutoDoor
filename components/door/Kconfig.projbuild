## components/door/Kconfig.projbuild
```kconfig
menu "AutoDoor: Door"

    config AUTODOOR_SERVO_GPIO
        int "Servo PWM GPIO"
        range 0 21
        default 1

    config AUTODOOR_DOOR_CLOSED_DEG
        int "Servo angle for the closed position (degrees)"
        range 0 180
        default 0

    config AUTODOOR_DOOR_OPEN_DEG
        int "Servo angle for the open position (degrees)"
        range 0 180
        default 120

    config AUTODOOR_DOOR_OPEN_HOLD_MS
        int "How long the door stays open (ms)"
        range 100 60000
        default 3000

endmenu
```

## components/health/Kconfig.projbuild
```kconfig
menu "AutoDoor: Health check"

    config AUTODOOR_HEALTH_TIMEOUT_S
        int "Seconds a freshly updated firmware has to prove it is healthy"
        range 10 600
        default 60

endmenu
```

## components/mqtt_mgr/Kconfig.projbuild
```kconfig
menu "AutoDoor: MQTT"

    config AUTODOOR_MQTT_TOPIC
        string "Topic that carries door commands"
        default "dormdoor006"

    config AUTODOOR_MQTT_BROKER
        string "Broker that mqtt subscribed"
        default "mqtts://bemfa.com:9503"

    config AUTODOOR_MQTT_KEEPALIVE_S
        int "MQTT keepalive (s)"
        range 10 1200
        default 60
        help
            esp-mqtt sends a PINGREQ every keepalive/2 seconds and drops the connection if no
            PINGRESP arrives within keepalive seconds. Bemfa's TCP protocol drops idle
            connections after 65 s, so keep keepalive/2 well below that.

    config AUTODOOR_MQTT_CLIENT_ID
        string "Client ID for authorize"
        default ""
        
endmenu
```

## components/ota_mgr/Kconfig.projbuild
```kconfig
menu "AutoDoor: OTA"

    config AUTODOOR_OTA_TIMEOUT_MS
        int "Network timeout while downloading firmware (ms)"
        range 1000 120000
        default 60000

endmenu
```

## components/wifi_mgr/Kconfig.projbuild
```kconfig
menu "AutoDoor: AP"

    config AUTODOOR_AP_SSID
        string "AP SSID"
        default "door"

    config AUTODOOR_AP_PASSWORD
        string "AP password"
        default "password"

endmenu

menu "AutoDoor: Wi-Fi power"

    config AUTODOOR_WIFI_LISTEN_INTERVAL
        int "Station listen interval (beacon intervals)"
        range 1 10
        default 3
        help
            With WIFI_PS_MAX_MODEM the station only wakes every N beacons (about 102 ms each).
            Worst-case delay of an incoming MQTT message is roughly N * 102 ms:
            3 = ~300 ms, 4 = ~410 ms, 5 = ~510 ms.

    config AUTODOOR_AP_KEEP_AFTER_IP_S
        int "Keep the config AP this long after the station gets an IP (s)"
        range 30 86400
        default 300
        help
            After this time the device switches to station-only mode so the radio can sleep.
            The AP is not switched off while a client is still connected to it. Power-cycling
            the device gives you this window again. Only applies when Wi-Fi credentials are
            saved; without them the device stays in AP-only mode.

    config AUTODOOR_AP_RETURN_AFTER_LOSS_S
        int "Bring the config AP back after this long without an IP (s)"
        range 30 86400
        default 300
        help
            Covers a changed router or wrong password, so the device can always be reconfigured.

endmenu

menu "AutoDoor: SNTP"

    config AUTODOOR_SNTP_URL
        string "SNTP server URL"
        default "ntp.aliyun.com"
        
endmenu
```

## main/Kconfig.projbuild
```kconfig
menu "AutoDoor: Commands"

    config AUTODOOR_CMD_OPEN
        string "MQTT payload that opens the door"
        default "openup"

endmenu

menu "AutoDoor: Power"

    config AUTODOOR_PM_MAX_FREQ_MHZ
        int "Max CPU frequency (MHz)"
        range 80 160
        default 160
        help
            Used by esp_pm_configure(). The CPU only runs this fast while something needs it
            (e.g. a TLS handshake) and scales down when idle. Ignored when
            CONFIG_PM_ENABLE is off.

    config AUTODOOR_PM_MIN_FREQ_MHZ
        int "Min CPU frequency (MHz)"
        range 10 80
        default 10
        help
            Valid ESP32-C3 values: 10, 20, 40, 80.

endmenu
```
